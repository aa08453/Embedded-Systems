## CMakeLists.txt
```
# SPDX-License-Identifier: Apache-2.0

cmake_minimum_required(VERSION 3.20.0)

# Find Zephyr base, required for Zephyr projects
find_package(Zephyr REQUIRED HINTS $ENV{ZEPHYR_BASE})

# Define the project name
project(HW3)

# Gather all .c files from the src directory
file(GLOB SOURCES "src/*.c")

# Gather all .h files from the inc directory (not directly added to the target, just for inclusion)
file(GLOB HEADERS "inc/*.h")

# Specify the source files for the 'app' target
target_sources(app PRIVATE ${SOURCES})

# Include the headers directory for the 'app' target
target_include_directories(app PRIVATE ${CMAKE_SOURCE_DIR}/inc)
```

## prj.conf
```kconfig
CONFIG_PRINTK=y
CONFIG_HEAP_MEM_POOL_SIZE=256
CONFIG_GPIO=y
CONFIG_SENSOR=y
```

## src/main.c
```c
#include <zephyr/kernel.h>
#include <zephyr/console/console.h>
#include <string.h>
#include "../inc/sensors.h"

#define SENSORS_THREAD_STACK_SIZE 1024
#define SENSORS_THREAD_PRIORITY 5

K_THREAD_STACK_DEFINE(sensors_stack, SENSORS_THREAD_STACK_SIZE);

int frequency; 

void init_threads(void *p1, void *p2, void *p3)
{
    int delay_ms = *((int *)p1); 
    k_thread_create(&sensors, sensors_stack, SENSORS_THREAD_STACK_SIZE, 
                    (k_thread_entry_t) sensors_thread, &delay_ms, NULL, NULL, 
                    SENSORS_THREAD_PRIORITY, 0, K_NO_WAIT);
}

int get_frequency_input()
{
    int frequency = 0;
    int input_char;
    char input_buffer[10];
    int i = 0;

    printk("Please enter a frequency between 10Hz and 50Hz: ");
    
    // Clear buffer before use
    memset(input_buffer, 0, sizeof(input_buffer));

    // Read input from UART (character by character)
    while (1) {
        input_char = getchar();  // Get one character from user input

        if (input_char == '\n' || input_char == '\r') {
            // Ignore carriage return and new line
            continue;
        }

        if (input_char >= '0' && input_char <= '9') {
            input_buffer[i++] = input_char;  // Add the digit to the buffer
            if (i >= sizeof(input_buffer) - 1) break;  // Prevent buffer overflow
        } else {
            printk("Invalid character! Only digits are allowed.\n");
            while (getchar() != '\n');  // Clear remaining input
            break;
        }

        // If the input is complete and we have a valid number, break the loop
        if (input_char == '\n') {
            break;
        }
    }

    // Convert input buffer to integer
    if (sscanf(input_buffer, "%d", &frequency) == 1 && frequency >= 10 && frequency <= 50) {
        printk("Valid frequency: %dHz\n", frequency);
    } else {
        printk("Invalid frequency. Please enter a value between 10Hz and 50Hz.\n");
    }

    return frequency;
}



int main(void)
{
    frequency = get_frequency_input();  // Get frequency input from the user
    int delay_ms = 1000 / frequency;        // Calculate delay in milliseconds
    
    printk("Frequency set to %dHz, delay set to %d ms\n", frequency, delay_ms);
    
    init_threads(&delay_ms, NULL, NULL);  // Pass delay_ms to the sensor thread

    return 0;
}
```

## inc/IR.h
```c
#ifndef IR_H
#define IR_H

void init_IR(void);

int read_IR(void);

#endif
```

## inc/US.h
```c
#ifndef US_H
#define US_H

void init_US(void);

int read_US(void);

#endif
```

## inc/sensors.h
```c
#ifndef SENSORS_H
#define SENSORS_H

typedef struct
{
    int IR_data;
    int US_data;
} sensors_data_t;

extern struct k_thread sensors;

void init_sensors();

sensors_data_t* read_sensors();

sensors_data_t* process_sensor_data(sensors_data_t* data);

void sensors_thread(void *p1, void *p2, void *p3);

#endif
```

## src/IR.c
```c
#include "../inc/IR.h"
#include <zephyr/drivers/gpio.h>
#include <zephyr/drivers/adc.h>
#include <zephyr/kernel.h>


#define IR_NODE DT_ALIAS(ir)
static const struct gpio_dt_spec ir = GPIO_DT_SPEC_GET(IR_NODE, gpios);


void init_IR(void)
{

    if (!gpio_is_ready_dt(&ir)) 
    {
        printk("GPIO device is not ready\n");
        return;
    }

    int ret = gpio_pin_configure_dt(&ir, GPIO_INPUT);
    if (ret < 0) {
        printk("Error configuring GPIO pin: %d\n", ret);
        return;
    }

}

int read_IR(void)
{
    int ir_state = gpio_pin_get_dt(&ir);
    printk("IR GPIO state: %d\n", ir_state);
    return ir_state;
}
```

## src/US.c
```c
#include <zephyr/kernel.h>
#include <zephyr/kernel/thread_stack.h>
#include <zephyr/drivers/gpio.h>
#include <zephyr/device.h>
#include <zephyr/sys/__assert.h>
#include <string.h>
#include <zephyr/sys_clock.h>
#include <limits.h>
#include "../inc/US.h"

#define ECHO_NODE DT_ALIAS(echo)
static const struct gpio_dt_spec echo = GPIO_DT_SPEC_GET(ECHO_NODE, gpios);

#define TRIG_NODE DT_ALIAS(trig)
static const struct gpio_dt_spec trig = GPIO_DT_SPEC_GET(TRIG_NODE, gpios);


#define MAX_WAIT_CYCLES 1000000

void init_US(void)
{

    if (!gpio_is_ready_dt(&echo) || !gpio_is_ready_dt(&trig)) 
    {
        printk("GPIO device is not ready\n");
        return;
    }

    // Configure the GPIO pin as input for ECHO and output for TRIG
    int echo_pin = gpio_pin_configure_dt(&echo, GPIO_INPUT);
    if (echo_pin < 0) 
    {
        printk("Error configuring ECHO GPIO pin: %d\n", echo_pin);
        return;
    }

    int trig_pin = gpio_pin_configure_dt(&trig, GPIO_OUTPUT);
    if (trig_pin < 0) 
    {
        printk("Error configuring TRIG GPIO pin: %d\n", trig_pin);
        return;
    }
}

int read_US(void)
{
    gpio_pin_set_dt(&trig, 1);
    k_busy_wait(10);  
    gpio_pin_set_dt(&trig, 0);

    uint64_t val = gpio_pin_get_dt(&echo);
    int timeout = 10000; // timeout after 10ms (adjust as necessary)

    // Wait for the echo pin to go high, with a timeout
    while (val == 0 && timeout > 0) {
        val = gpio_pin_get_dt(&echo);
        k_busy_wait(1);  // Small delay to avoid burning CPU
        timeout--;
    }

    if (timeout <= 0) {
        printk("Timeout waiting for echo to go high.\n");
        return -1;
    }

    uint64_t start_time = k_cycle_get_32();
    while (gpio_pin_get_dt(&echo) == 1) {
        // Optionally add another timeout check here
        if (timeout <= 0) {
            printk("Timeout waiting for echo to finish.\n");
            return -1;
        }
        timeout--;
    }

    uint64_t stop_time = k_cycle_get_32();
    uint64_t cycles_spent = stop_time - start_time;

    uint64_t nanoseconds_spent = (cycles_spent * 1000000000UL) / sys_clock_hw_cycles_per_sec();
    uint32_t cm = nanoseconds_spent / 58000; // Convert to centimeters

    printk("Distance: %d cm\n", cm);
    return cm;
}
```

## src/sensors.c
```c
#include <zephyr/kernel.h>
#include "../inc/sensors.h"
#include "../inc/IR.h"
#include "../inc/US.h"

struct k_thread sensors;

// Function to initialize the sensors
void init_sensors()
{
    init_IR();
    init_US();
}

// Function to read the sensors and return the data
sensors_data_t* read_sensors()
{
    sensors_data_t* data = k_malloc(sizeof(sensors_data_t));  // Allocate memory for the data structure
    if (data == NULL) 
    {
        printk("Memory allocation failed\n");
        return NULL;  // Handle the error if memory allocation fails
    }
    data->IR_data = read_IR();
    data->US_data = read_US();
    return data;
}

// Function to process sensor data (you can implement additional logic here if needed)
sensors_data_t* process_sensor_data(sensors_data_t* data)
{
    return data;
}

// Sensors thread function
void sensors_thread(void *p1, void *p2, void *p3)
{
    int delay_ms = *((int *)p1);  // Retrieve the delay value passed from main

    init_sensors();

    sensors_data_t* sensor_data;

    while (1)
    {   
        sensor_data = read_sensors();

        if (sensor_data != NULL) 
        {
            sensor_data = process_sensor_data(sensor_data);
            k_free(sensor_data);  // Free the allocated memory
        }

        k_sleep(K_MSEC(delay_ms));  // Delay based on user input frequency
    }
}
```
